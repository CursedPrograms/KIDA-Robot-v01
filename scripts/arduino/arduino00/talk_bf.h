// talk_bf.h - the fleet's Brainfuck phrasebook. GENERATED by
// RIFT/Fleet/brainfuck_talk.py - edit PHRASES there and rerun, don't edit here.
//
// Every phrase is a Brainfuck program that prints its words; a robot says it
// by beeping the source, one tone per symbol (bfToneHz/bfToneMs), scaled to
// its own voice. Utterances 0-6 are phrases, 7-13 the matching replies:
// 0 hello, 1 how are you, 2 happy, 3 curious, 4 sleepy, 5 let's play, 6 bye.
#pragma once
#include <Arduino.h>

#define TALK_UTTERANCES 14
#define TALK_GAP_MS 10

static const char TALK_BF_0[] PROGMEM = "++++++++[>+++++++++++++<-]>.+.";  // hello phrase -> "hi" (1.2 s)
static const char TALK_BF_1[] PROGMEM = "++++++++[>+++++++++++++<-]>.++++++++++.+++.<++++++[>---------<-]>.";  // how are you phrase -> "hru?" (2.7 s)
static const char TALK_BF_2[] PROGMEM = "+++++++++++[>+++++++++++<-]>.<++++[>------<-]>.<++++[>++++++<-]>.";  // happy phrase -> "yay" (2.6 s)
static const char TALK_BF_3[] PROGMEM = "++++++++[>+++++++++++++<-]>.+++++.<+++++[>---------<-]>-.";  // curious phrase -> "hm?" (2.3 s)
static const char TALK_BF_4[] PROGMEM = "+++++++++++[>+++++++++++<-]>+...";  // sleepy phrase -> "zzz" (1.4 s)
static const char TALK_BF_5[] PROGMEM = "++++++++[>++++++++++++++<-]>.----.-----------.<++++[>++++++<-]>.";  // play phrase -> "play" (2.6 s)
static const char TALK_BF_6[] PROGMEM = "+++++++[>++++++++++++++<-]>.<++++[>++++++<-]>-.<++++[>-----<-]>.";  // bye phrase -> "bye" (2.6 s)
static const char TALK_BF_7[] PROGMEM = "++++++++[>+++++++++++++<-]>.+.<++++++++[>---------<-]>.";  // hello reply -> "hi!" (2.2 s)
static const char TALK_BF_8[] PROGMEM = "++++++++++[>+++++++++++<-]>+.----.<+++++++[>-------<-]>.<++++[>----<-]>-.";  // how are you reply -> "ok:)" (3.0 s)
static const char TALK_BF_9[] PROGMEM = "+++++++++++[>+++++++++++<-]>.<++++[>------<-]>.<++++[>++++++<-]>.<++++++++[>-----------<-]>.";  // happy reply -> "yay!" (3.7 s)
static const char TALK_BF_10[] PROGMEM = "++++++++++[>+++++++++++<-]>+.-------.<+++++++[>----------<-]>-.";  // curious reply -> "oh!" (2.5 s)
static const char TALK_BF_11[] PROGMEM = "++++++++++[>+++++++++++<-]>.-----.+++++++++++.---------------.";  // sleepy reply -> "nite" (2.6 s)
static const char TALK_BF_12[] PROGMEM = "+++++++++++[>+++++++++++<-]>.<++++[>-----<-]>.++++++++++++++.<+++++++++[>---------<-]>-.";  // play reply -> "yes!" (3.6 s)
static const char TALK_BF_13[] PROGMEM = "+++++++[>++++++++++++++<-]>.<++++[>++++++<-]>-.<++++[>-----<-]>.<++++++[>-----------<-]>--.";  // bye reply -> "bye!" (3.7 s)

static const char* const TALK_BF[TALK_UTTERANCES] PROGMEM = {
  TALK_BF_0, TALK_BF_1, TALK_BF_2, TALK_BF_3, TALK_BF_4, TALK_BF_5, TALK_BF_6, TALK_BF_7, TALK_BF_8, TALK_BF_9, TALK_BF_10, TALK_BF_11, TALK_BF_12, TALK_BF_13
};

// What each utterance prints, for logs and web pages.
static const char* const TALK_TEXT[TALK_UTTERANCES] = {
  "hi", "hru?", "yay", "hm?", "zzz", "play", "bye", "hi!", "ok:)", "yay!", "oh!", "nite", "yes!", "bye!"
};

// Symbol n (0 = end) of utterance u, read from flash.
static inline char talkSymbol(uint8_t u, uint16_t n) {
  const char* p = (const char*)pgm_read_ptr(&TALK_BF[u]);
  return (char)pgm_read_byte(p + n);
}

static inline uint16_t bfToneHz(char c) {
  switch (c) {
    case '+': return 1568;
    case '-': return 784;
    case '>': return 1319;
    case '<': return 1047;
    case '[': return 880;
    case ']': return 1175;
    case '.': return 2093;
    case ',': return 523;
  }
  return 0;
}

static inline uint16_t bfToneMs(char c) { return c == '.' ? 80 : 28; }

// ---- Player ----
// Non-blocking: talkStart(u), then call talkStep(pin, voicePct) every loop;
// each symbol is a tone() of bfToneHz * voicePct / 100. Returns false once
// it's quiet.
static int8_t        talkUtterance = -1;
static uint16_t      talkPos       = 0;
static unsigned long talkNextMs    = 0;

static inline void talkStart(int u) {
  if (u < 0 || u >= TALK_UTTERANCES) return;
  talkUtterance = u;
  talkPos       = 0;
  talkNextMs    = 0;
}

static inline bool talkStep(uint8_t pin, uint8_t voicePct) {
  if (talkUtterance < 0) return false;
  if (millis() < talkNextMs) return true;
  char c = talkSymbol(talkUtterance, talkPos++);
  if (!c) { talkUtterance = -1; noTone(pin); return false; }
  uint16_t ms = bfToneMs(c);
  tone(pin, (unsigned long)bfToneHz(c) * voicePct / 100, ms);
  talkNextMs = millis() + ms + TALK_GAP_MS;
  return true;
}

// Blocking: plays utterance u through the robot's own beep(freq, ms), for
// sketches whose beep() has to pause something (IRremote shares Timer2).
static inline void talkPlayBlocking(int u, uint8_t voicePct, void (*beep)(unsigned int, unsigned int)) {
  if (u < 0 || u >= TALK_UTTERANCES) return;
  for (uint16_t n = 0;; n++) {
    char c = talkSymbol(u, n);
    if (!c) break;
    beep((unsigned long)bfToneHz(c) * voicePct / 100, bfToneMs(c));
    delay(TALK_GAP_MS);
  }
}
